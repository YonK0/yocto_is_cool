## meta-aero-bsp/conf/layer.conf
```bitbake
# We define the layer here

LAYERVERSION_mycustom = "1.0"

BBPATH .= ":${LAYERDIR}"
BBFILES += "${LAYERDIR}/recipes-*/*/*.bb \
            ${LAYERDIR}/recipes-*/*/*.bbappend"

# depends on openmbedded-core and meta-raspberrypi
LAYERDEPENDS_mycustom = "openembedded-core meta-raspberrypi"
LAYERSERIES_COMPAT_mycustom = "*/"


RAUC_KEY_FILE ?= "${LAYERDIR}/recipes-core/rauc/files/development-1.key.pem"
RAUC_CERT_FILE ?= "${LAYERDIR}/recipes-core/rauc/files/development-1.cert.pem"
RAUC_KEYRING_FILE ?= "${LAYERDIR}/recipes-core/rauc/files/ca.cert.pem"
RAUC_ENCRYPTION_KEY ?= "${LAYERDIR}/recipes-core/rauc/files/bundle-encryption.key"
RAUC_ENCRYPTION_CERT ?= "${LAYERDIR}/recipes-core/rauc/files/bundle-encryption.cert"
```

## meta-aero-img/conf/layer.conf
```bitbake
# We define the layer here

LAYERVERSION_mycustom = "1.0"

BBPATH .= ":${LAYERDIR}"
BBFILES += "${LAYERDIR}/recipes-*/*/*.bb \
            ${LAYERDIR}/recipes-*/*/*.bbappend"

# depends on openmbedded-core and meta-raspberrypi
LAYERDEPENDS_mycustom = ""
LAYERSERIES_COMPAT_mycustom = "*/"
```

## meta-aero-img/wic/dev-image.wks
```
# Inspired from sdimage-raspberrypi.wks
# Adding /data partition : for now it's empty , size 80MB

part /boot --source bootimg-partition --ondisk mmcblk0 --fstype=vfat --label boot --active --align 4096 --size 100
part / --source rootfs --ondisk mmcblk0 --fstype=ext4 --label root --align 4096
part /data --source empty --ondisk mmcblk0 --fstype=ext4 --label data --align 4096 --size 80
```

## meta-pizero-bsp/conf/machine/pizero.conf
```bitbake
require conf/machine/raspberrypi0-2w-64.conf

# Emergency mode
#CMDLINE:append = " init=/bin/sh"

#Kernel optimization
MACHINE_FEATURES:remove = 'screen touchscreen alsa bluetooth vc4graphics'
MACHINE_FEATURES:append = " rtc"
#Append configs to config.txt ##################
#enable uart
ENABLE_UART = "1"

##########Disable bootloader configs ###########
#should be removed if u-boot is defined
RPI_EXTRA_CONFIG += '\n\
# Disable all unnecessary features\n\
disable_splash=1\n\
boot_delay=0\n\
disable_overscan=1\n\
# Minimal GPU memory\n\
gpu_mem=16\n\
# Disable audio completely\n\
dtparam=audio=off\n\
# Disable camera\n\
start_x=0\n\
# Disable HDMI\n\
hdmi_blanking=2\n\
'
#################################################
########## custom dts overlay ###################
#Enable the overlay in config.txt
IMAGE_BOOT_FILES:append = "myled.dtbo"
KERNEL_DEVICETREE:append = " overlays/myled.dtbo"
#################################################
########## Enable build information output ######
#Enabling build information output ? still confused where that information.
INHERIT += "buildhistory"
BUILDHISTORY_COMMIT = "1"
#################################################
#Enabling u-boot, enough using rspi GPU firmware bootloader
RPI_USE_U_BOOT = "1"
```

## meta-pizero-sw/conf/layer.conf
```bitbake
# We define the layer here

LAYERVERSION_mycustom = "1.0"

BBPATH .= ":${LAYERDIR}"
BBFILES += "${LAYERDIR}/recipes-*/*/*.bb \
            ${LAYERDIR}/recipes-*/*/*.bbappend"

# depends on openmbedded-core and meta-raspberrypi
LAYERDEPENDS_mycustom = ""
LAYERSERIES_COMPAT_mycustom = "*/"

############################# RAUC integration ###########################
RAUC_BUNDLE_ENCRYPT = "1"
RAUC_KEY_FILE ?= "${LAYERDIR}/recipes-core/rauc/files/development-1.key.pem"
RAUC_CERT_FILE ?= "${LAYERDIR}/recipes-core/rauc/files/development-1.cert.pem"
RAUC_KEYRING_FILE ?= "${LAYERDIR}/recipes-core/rauc/files/ca.cert.pem"
RAUC_ENCRYPTION_KEY ?= "${LAYERDIR}/recipes-core/rauc/files/bundle-encryption.key"
RAUC_ENCRYPTION_CERT ?= "${LAYERDIR}/recipes-core/rauc/files/bundle-encryption.cert"
######################## Initramfs Integration ###########################
INITRAMFS_IMAGE = "base-initramfs"
INITRAMFS_IMAGE_BUNDLE = "1"

# Removing hardcoded root=/dev/mmcblk0p2 rootfstype=ext4 which leads skip initramfs and directly mount rootfs
CMDLINE_ROOTFS = ""

IMAGE_BOOT_FILES:append = " Image-initramfs-${MACHINE}.bin;Image "
```
