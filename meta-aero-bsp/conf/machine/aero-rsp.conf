## meta-aero-bsp/conf/machine/aero-rsp.conf
```bitbake
require conf/machine/raspberrypi0-2w.conf

# Emergency mode
#CMDLINE:append = " init=/bin/sh"

#Kernel optimization
MACHINE_FEATURES:remove = 'keyboard screen touchscreen alsa bluetooth vc4graphics'

#Append configs to config.txt ##################
#enable uart
ENABLE_UART = "1"

##########Disable bootloader configs ###########
#should be removed if u-boot is defined
RPI_EXTRA_CONFIG += '\n\
# Disable all unnecessary features\n\
disable_splash=1\n\
boot_delay=0\n\
disable_overscan=1\n\
# Minimal GPU memory\n\
gpu_mem=16\n\
# Disable audio completely\n\
dtparam=audio=off\n\
# Disable camera\n\
start_x=0\n\
# Disable HDMI\n\
hdmi_blanking=2\n\
'
#################################################
########## custom dts overlay ###################
#Enable the overlay in config.txt
IMAGE_BOOT_FILES:append = "myled.dtbo"
KERNEL_DEVICETREE:append = " overlays/myled.dtbo"
#################################################
########## Custom kernel module #################
IMAGE_INSTALL:append = " my-module"
#################################################
########## Enable build information output ######
#Enabling build information output ? still confused where that information.
INHERIT += "buildhistory"
BUILDHISTORY_COMMIT = "1"
#Remove root password############################
#I think it's empty as a default need to be checked
IMAGE_FEATURES += "empty-root-password"
#################################################
#Enabling u-boot, enough using rspi GPU firmware bootloader
RPI_USE_U_BOOT = "1"
```

## meta-aero-distro/conf/distro/aero-distro.conf
```bitbake
DISTRO ?= "aero-distro"
DISTRO_NAME ?= "Stupid distro ^_^"
DISTRO_VERSION ?= "1.0"

# dev / fab
IMAGE_TYPE ?= "dev"

require files/${@d.getVar("IMAGE_TYPE")}.inc

DISTRO_FEATURES = "ext2"

#This feature is added by DISTRO_FEATURES_BACKFILL
DISTRO_FEATURES:remove = "pulseaudio"

#Disable GPLv3 packages :  AGPL-3.0-only AGPL-3.0-or-later GPL-3.0-only GPL-3.0-or-later LGPL-3.0-only
INCOMPATIBLE_LICENSE:pn-core-image-minimal = "GPL-3.0-only"

####################################################
#coreutils + bash (default):
# bash, tar, vi, ls, cp, mv, cat, grep, sed, awk, etc.
## Total size: ~15-25MB for all utilities combined
### Licenses: Mix of GPL-2.0 and GPL-3.0
################### VS #############################
#busybox:
#sh, vi, tar, ls, cp, mv, cat, grep, sed, awk, httpd, telnetd, etc.
## Single binary (~1-2MB)
### GPL-2.0 only
######=> busybox >>>> (coreutils + bash):
#####################################################
IMAGE_INSTALL += "busybox"

#Enable image build info
INHERIT += "image-buildinfo"
```

## meta-pizero-distro/conf/layer.conf
```bitbake
# We define the layer here

LAYERVERSION_mycustom = "1.0"

BBPATH .= ":${LAYERDIR}"
BBFILES += "${LAYERDIR}/recipes-*/*/*.bb \
            ${LAYERDIR}/recipes-*/*/*.bbappend"

LAYERDEPENDS_mycustom = "core"
LAYERSERIES_COMPAT_mycustom = "*/"
```
